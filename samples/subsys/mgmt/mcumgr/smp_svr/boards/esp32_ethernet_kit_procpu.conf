## samples/subsys/mgmt/mcumgr/smp_svr/boards/esp32_ethernet_kit_procpu.conf
```kconfig
# Enable Ethernet Driver
CONFIG_ETH_ESP32=y
CONFIG_NET_L2_ETHERNET=y

# Disable SPI RAM, seems to break booting
CONFIG_ESP_SPIRAM=n
```

## soc/espressif/esp32/Kconfig
```kconfig
# Copyright (c) 2023 Espressif Systems (Shanghai) Co., Ltd.
# Copyright (c) 2025 Proton Camera Innovations GmbH
# SPDX-License-Identifier: Apache-2.0

config SOC_SERIES_ESP32
	select XTENSA
	select CLOCK_CONTROL
	select DYNAMIC_INTERRUPTS
	select ARCH_HAS_GDBSTUB
	select ARCH_SUPPORTS_COREDUMP
	select PINCTRL
	select HAS_ESPRESSIF_HAL
	select CPU_HAS_FPU
	select HAS_PM
	select HAS_POWEROFF

if SOC_SERIES_ESP32

config ESP32_MCUBOOT_IRAM
	hex "Amount of non-reclaimable IRAM which can be used by MCUboot"
	range 0x0 0x8000
	default 0x2000
	depends on MCUBOOT || BOOTLOADER_MCUBOOT
	help
	  This value can be optimized to reduce the amount of memory used up
	  by MCUboot which can not be used by the application. If the value
	  is too low a linker warning will be shown.

	  The value may have to be increased depending on the features enabled
	  for MCUboot (e.g. logging). The maximum value is 32kB.

config ESP32_BT_RESERVE_DRAM
	hex "Bluetooth controller reserved RAM region"
	default 0xdb5c if BT
	default 0

config ESP32_SRAM1_HEAP_SIZE
	hex "Amount of SRAM1 memory which is used as heap for the ESP heap allocator"
	range 0x0 0x18000
	default 0x10000 if WIFI_ESP32 || BT_ESP32
	default 0

	help
	  ESP32 has two banks of size 200kB (SRAM2) and 128kB (SRAM1) which can
	  be used as DRAM. SRAM2 (minus some shared memory) is completely used for
	  DRAM.
	  SRAM1 can be split between IRAM and HEAP which can be allocated by the ESP
	  heap allocator for WiFi and Bluetooth operation. The maximum memory is
	  96kB, the rest is reserved for ROM functions.
	  The remaining SRAM1 memory which is not used for the heap is added to the
	  IRAM.
	  By setting this config to 0 the ESP heap will be placed in the normal DRAM
	  section, thus reduce the available DRAM for the application. This should
	  only be done if the additional IRAM is needed and there is enough DRAM
	  available in SRAM2.

config ESP32_DEEP_SLEEP_WAKEUP_DELAY
	int "Extra delay in deep sleep wake stub (in us)"
	default 2000
	range 0 5000
	help
	  When ESP32 exits deep sleep, the CPU and the flash chip are powered on
	  at the same time. CPU will run deep sleep stub first, and then
	  proceed to load code from flash. Some flash chips need sufficient
	  time to pass between power on and first read operation. By default,
	  without any extra delay, this time is approximately 900us, although
	  some flash chip types need more than that.

	  By default extra delay is set to 2000us. When optimizing startup time
	  for applications which require it, this value may be reduced.

	  If you are seeing "flash read err, 1000" message printed to the
	  console after deep sleep reset, try increasing this value.

config ESP32_EMAC
	bool
	default y if ETH_ESP32
	default y if MDIO_ESP32
	default n
	help
	  Hidden option to enable the ESP32 Ethernet MAC driver.
	  Both Ethernet and MDIO depend on this driver.
	  This option allows enabling MDIO independently of Ethernet.

if ESP32_EMAC

config ETH_DMA_BUFFER_SIZE
	int "Ethernet DMA buffer size (Byte)"
	range 256 1600
	default 512
	help
	  Set the size of each buffer used by Ethernet MAC DMA.

config ETH_DMA_RX_BUFFER_NUM
	int "Amount of Ethernet DMA Rx buffers"
	range 3 30
	default 10
	help
	  Number of DMA receive buffers. Each buffer's size is ETH_DMA_BUFFER_SIZE.
	  Larger number of buffers could increase throughput somehow.

config ETH_DMA_TX_BUFFER_NUM
	int "Amount of Ethernet DMA Tx buffers"
	range 3 30
	default 10
	help
	  Number of DMA transmit buffers. Each buffer's size is ETH_DMA_BUFFER_SIZE.
	  Larger number of buffers could increase throughput somehow.

endif # ESP32_EMAC config

endif # SOC_SERIES_ESP32
```
